// this script is completely generated by https://chat.openai.com/chat 
#include <ESP8266WiFi.h>
#include <ESP8266HTTPClient.h>
#include <WiFiUdp.h>
#include <time.h>
#include <Adafruit_NeoPixel.h>

#define LED_PIN D4  // note: the shield says D2 but should be D4 despite the fact that the led is connected to D2 :-(
#define LED_COUNT 1

const char* ssid = "ssid";
const char* password = "password";

const char* ntpServer = "pool.ntp.org";
const long  gmtOffset_sec = 3600;
const int   daylightOffset_sec = 3600;

const char* host_rivm = "www.rivm.nl";
const int   httpsPort = 443;

Adafruit_NeoPixel strip(LED_COUNT, LED_PIN, NEO_GRB + NEO_KHZ800);

void setup() {
  Serial.begin(115200);
  WiFi.begin(ssid, password);
  while (WiFi.status() != WL_CONNECTED) {
    delay(1000);
    Serial.println("Connecting to WiFi...");
  }
  configTime(gmtOffset_sec, daylightOffset_sec, ntpServer);
  while (time(nullptr) < 1000000000UL) {
    delay(1000);
    Serial.println("Waiting for time sync...");
  }
  strip.begin();
}

void loop() {
  time_t now;
  struct tm timeinfo;
  char datetime[20];

  now = time(nullptr);
  localtime_r(&now, &timeinfo);
  strftime(datetime, sizeof(datetime), "%Y-%m-%d %H:%M:%S", &timeinfo);
  Serial.print("Current datetime: ");
  Serial.println(datetime);

  String url = "/media/lml/stookalert/stookalert_";
  char date[11];
  strftime(date, sizeof(date), "%Y%m%d", &timeinfo);
  url += date;
  url += ".json";
  Serial.print("URL: https://");
  Serial.print(host_rivm);
  Serial.println(url);

  WiFiClientSecure client;
  client.setInsecure();
  HTTPClient http_rivm;
  http_rivm.begin(client, "https://" + String(host_rivm) + url);
  int httpCode = http_rivm.GET();
  Serial.print("API status: ");
  Serial.println(httpCode);
  if (httpCode == 200) {
    String payload = http_rivm.getString();
    Serial.println(payload);
    int drenthe_value = payload.substring(payload.indexOf("Drenthe\":")+9, payload.indexOf("Drenthe\":")+10).toInt();
    Serial.print("Drenthe value: ");
    Serial.println(drenthe_value);
    if (drenthe_value == 0) {
      strip.setPixelColor(0, 0, 10, 0); // Green
    } else {
      strip.setPixelColor(0, 10, 0, 0); // Red
    }
    strip.show();
  }
  http_rivm.end();
  delay(60000);
}
